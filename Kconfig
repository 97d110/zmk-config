## Kconfig
```kconfig
# Copyright (c) 2026 The ZMK Contributors
# SPDX-License-Identifier: MIT

menu "Eyelash Sofle display engine"

config ZMK_DUAL_DISPLAY_SCENE_ENGINE
    bool "Local dual nice!view scene engine"
    default n
    depends on ZMK_DISPLAY
    depends on SHIELD_NICE_VIEW
    select LV_USE_CANVAS
    help
      Enables the local dual-display scene engine for the Eyelash Sofle
      nice!view builds. Keep this disabled for release firmware until the
      renderer has been validated on hardware, because it replaces the upstream
      nice!view status screen.

if ZMK_DUAL_DISPLAY_SCENE_ENGINE

config ZMK_DUAL_DISPLAY_SCENE_ENGINE_MOCK_RENDERER
    bool "Use temporary placeholder LVGL renderer"
    default y
    help
      Selects the mock LVGL renderer while the durable scene renderer and
      asset pipeline are still being built. The ZMK display entry point uses a
      stable render contract so this temporary implementation can be removed
      without changing core planning code.

config ZMK_DUAL_DISPLAY_TYPING_CHECK_PERIOD_MS
    int "Typing activity check period in milliseconds"
    default 1000
    range 1 60000
    help
      Sets the display-only typing check period. Keypresses mark the current
      period as active; when a period completes without a keypress, the display
      activity returns to idle.

config ZMK_DUAL_DISPLAY_ANIMATION_REFRESH_PERIOD_MS
    int "Animation refresh period in milliseconds"
    default 100
    range 50 5000
    help
      Sets the display-only refresh cadence used while the renderer-local animation
      context reports active animation work. This does not change the core
      typing activity check period or normal ZMK event handling.

module = ZMK_DUAL_DISPLAY_SCENE_ENGINE
module-str = zmk_dual_display
source "subsys/logging/Kconfig.template.log_config"

endif # ZMK_DUAL_DISPLAY_SCENE_ENGINE

endmenu
```

## dts/bindings/behaviors/zmk,behavior-dual-display-layer-sync.yaml
```yaml
# Copyright (c) 2026 The ZMK Contributors
# SPDX-License-Identifier: MIT

description: Dual display split layer sync behavior

compatible: "zmk,behavior-dual-display-layer-sync"

properties:
  label:
    type: string
    required: false
    deprecated: true
  "#binding-cells":
    type: int
    required: true
    const: 1

binding-cells:
  - param1
```
